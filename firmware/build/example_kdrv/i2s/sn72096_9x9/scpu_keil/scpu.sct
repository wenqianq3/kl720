#!armcc -E

#include "memorymap.h"

SCPU IRAM_START IRAM_SIZE
{
    SCPU_STARTUP + 0
    {
        *(VECTOR_TABLE, +First)
    }

    SCPU_HEADER + 0 FIXED               ;should always start from offset xxxx
    {
        *(IMAGE_HEADER, +First)
    }

    SCPU_RO + 0
    {
        *(InRoot$$Sections)
        *(+RO)
    }

    SCPU_RW + 0
    {
        *(+RW)
    }

    SCPU_ZI + 0
    {
        *(+ZI)
    }
}

